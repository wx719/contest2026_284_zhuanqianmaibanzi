## app/velapoka/Kconfig
```kconfig
#
# For a description of the syntax of this configuration file,
# see the file kconfig-language.txt in the NuttX tools repository.
#

menuconfig EXAMPLES_VELAPOKA
	tristate "VelaPoka visual assembly terminal"
	default n
	depends on DRIVERS_VIDEO
	depends on GRAPHICS_LVGL
	depends on LV_USE_IMAGE
	depends on LV_USE_NUTTX
	depends on LV_USE_NUTTX_TOUCHSCREEN
	depends on NET && NET_TCP
	select NET_SOCKOPTS
	select NET_TCPBACKLOG
	select NETUTILS_NETLIB
	---help---
		Build the VelaPoka LVGL product application.  It captures packed
		RAW10 frames from the V4L2 camera, converts them to a grayscale live
		preview, renders the split-screen touch UI and provides read-only
		Ethernet HTTP export.

if EXAMPLES_VELAPOKA

config EXAMPLES_VELAPOKA_PRIORITY
	int "VelaPoka task priority"
	default 100

config EXAMPLES_VELAPOKA_STACKSIZE
	int "VelaPoka task stack size"
	default 16384

config EXAMPLES_VELAPOKA_FB_DEVPATH
	string "Framebuffer device path"
	default "/dev/fb0"

config EXAMPLES_VELAPOKA_INPUT_DEVPATH
	string "Touchscreen device path"
	default "/dev/input0"

config EXAMPLES_VELAPOKA_CAMERA_DEVPATH
	string "Camera device path"
	default "/dev/video0"

config EXAMPLES_VELAPOKA_CAMERA_PRIORITY
	int "Camera capture thread priority"
	default 110

config EXAMPLES_VELAPOKA_CAMERA_STACKSIZE
	int "Camera capture thread stack size"
	default 8192

config EXAMPLES_VELAPOKA_PREVIEW_GAIN
	int "RAW10 preview gain"
	range 1 16
	default 4
	---help---
		Multiply the high eight bits of each RAW10 Bayer sample by this
		value before clipping it to the grayscale preview range.

config EXAMPLES_VELAPOKA_STORAGE_DEVPATH
	string "MicroSD block device path"
	default "/dev/mmcsd0"

config EXAMPLES_VELAPOKA_STORAGE_MOUNTPOINT
	string "MicroSD FAT mount point"
	default "/mnt/sdcard"

config EXAMPLES_VELAPOKA_STORAGE_PRIORITY
	int "Storage worker priority"
	default 90

config EXAMPLES_VELAPOKA_STORAGE_STACKSIZE
	int "Storage worker stack size"
	default 4096

config EXAMPLES_VELAPOKA_NETWORK_PORT
	int "HTTP export port"
	range 1 65535
	default 8080
	depends on NET && NET_TCP

config EXAMPLES_VELAPOKA_NETWORK_PRIORITY
	int "HTTP export worker priority"
	default 85
	depends on NET && NET_TCP

config EXAMPLES_VELAPOKA_NETWORK_STACKSIZE
	int "HTTP export worker stack size"
	default 6144
	depends on NET && NET_TCP

config EXAMPLES_VELAPOKA_NETWORK_IPADDR
	hex "Ethernet static IPv4 address"
	default 0x0a000002
	depends on NET && NET_TCP
	---help---
		Static IPv4 address for eth0 in host byte order.  The default is
		10.0.0.2.

config EXAMPLES_VELAPOKA_NETWORK_NETMASK
	hex "Ethernet IPv4 netmask"
	default 0xffffff00
	depends on NET && NET_TCP

config EXAMPLES_VELAPOKA_NETWORK_ROUTER
	hex "Ethernet IPv4 router"
	default 0x0a000001
	depends on NET && NET_TCP

endif # EXAMPLES_VELAPOKA
```

## board/contest_board/Kconfig
```kconfig
#
# ESP32-P4 Function EV Board vendor configuration
#

config ESP32P4_FUNCTION_EV_BOARD_VENDOR
	bool
	default y

menu "VelaPoka visual assembly terminal"

config VELAPOKA_BSP
	bool "Enable the VelaPoka product BSP"
	default n
	select ESPRESSIF_I2C_BITBANG
	---help---
		Enable the board resource description, safe control GPIO setup and
		the /dev/velapoka BSP status device.  The product configuration keeps
		the proven UART/NSH recovery path available if an optional peripheral
		fails during bring-up.  The initial GT911 port uses the board's
		GPIO7/GPIO8 I2C wiring through the NuttX software-I2C lower half;
		the ESP32-P4 hardware controller can replace it after its HAL port is
		updated independently.

config VELAPOKA_TOUCHSCREEN
	bool "Enable GT911 polling touchscreen"
	default y
	depends on VELAPOKA_BSP
	select INPUT
	select INPUT_TOUCHSCREEN
	select SCHED_LPWORK
	---help---
		Register the GT911 controller as a NuttX touchscreen lower half.  The
		LCD adapter does not route GT911 INT to ESP32-P4, therefore the BSP
		uses periodic I2C polling.

config VELAPOKA_DISPLAY
	bool "Enable EK79007 MIPI-DSI display bring-up"
	default y
	depends on VELAPOKA_BSP
	select ESPRESSIF_MIPI_DSI
	select DRIVERS_VIDEO
	select VIDEO_FB
	select FB_UPDATE
	---help---
		Power the ESP32-P4 D-PHY, initialize the EK79007 panel, allocate an
		RGB888 framebuffer and register it as /dev/fb0.  The DSI hardware
		color-bar generator remains available as a fallback if framebuffer
		allocation or registration fails during bring-up.

config VELAPOKA_CAMERA
	bool "Enable AS-AG638A32M2-50 (SC2336) camera"
	default n
	depends on VELAPOKA_BSP
	select DRIVERS_VIDEO
	select VIDEO_STREAM
	select SCHED_HPWORK
	---help---
		Enable bring-up of the SC2336 MIPI-CSI camera module fitted to the
		Function EV Board.  The reference application uses two-lane RAW10
		at 1280x720 and 30 frames per second.  The first bring-up stage
		verifies the SCCB connection by reading PID 0xcb3a at address 0x30.
		The sensor is registered as /dev/video0 using packed BGGR RAW10.
		The CSI capability is marked ready after the first completed frame.

config VELAPOKA_SDCARD
	bool "Enable MicroSD card (hardware SPI mode)"
	default n
	select ESPRESSIF_SPI2
	select ESPRESSIF_SPI_SWCS
	select MMCSD
	select MMCSD_SPI
	select FS_FAT
	---help---
		Register the on-board MicroSD socket as /dev/mmcsd0 using the
		ESP32-P4 SPI2 lower half with GPIO matrix routing.
		The wiring follows Espressif's official BSP: CLK=GPIO43,
		MOSI/CMD=GPIO44, MISO/D0=GPIO39 and CS/D3=GPIO42.

config VELAPOKA_WIFI
	bool "Enable ESP32-C6 ESP-Hosted Wi-Fi"
	default n
	depends on VELAPOKA_BSP
	select NET
	select DRIVERS_WIRELESS
	select DRIVERS_IEEE80211
	select NETDEV_WIRELESS_IOCTL
	select SCHED_LPWORK
	---help---
		Register the on-board ESP32-C6 as wlan0 using ESP-Hosted 0.0.6
		over the ESP32-P4 SDIO host.  This option provides only the NuttX
		network driver and wireless ioctls; it does not add a Wi-Fi app.

if VELAPOKA_WIFI

config VELAPOKA_WIFI_SDIO_FREQUENCY
	int "ESP-Hosted SDIO clock frequency"
	range 1000000 40000000
	default 20000000

endif # VELAPOKA_WIFI

if VELAPOKA_TOUCHSCREEN

config VELAPOKA_TOUCHSCREEN_PATH
	string "Touchscreen device path"
	default "/dev/input0"

config VELAPOKA_TOUCHSCREEN_SAMPLE_CACHES
	int "Touchscreen sample cache entries"
	range 4 128
	default 32

config VELAPOKA_TOUCHSCREEN_SAMPLE_DELAY
	int "Touchscreen polling delay (ticks)"
	range 1 100
	default 1
	---help---
		Delay between GT911 status reads.  Keep this at one scheduler tick
		for responsive taps; the velapoka configuration uses a 10 ms tick.

endif # VELAPOKA_TOUCHSCREEN

endmenu
```
